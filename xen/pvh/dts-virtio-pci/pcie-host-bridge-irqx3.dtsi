pcie@f100000000 {
	#address-cells = <0x03>;
	dma-coherent;
	bus-range = <0x00 0xff>;
	reg-names = "ecam";
	interrupt-map = <0x0000 0x00 0x00 0x01 0xfde8 0x00 0x0c 0x04
	                 0x0000 0x00 0x00 0x02 0xfde8 0x00 0x0d 0x04
			 0x0000 0x00 0x00 0x03 0xfde8 0x00 0x0e 0x04
			 0x0000 0x00 0x00 0x04 0xfde8 0x00 0x0f 0x04
			 0x0800 0x00 0x00 0x01 0xfde8 0x00 0x0d 0x04
			 0x0800 0x00 0x00 0x02 0xfde8 0x00 0x0e 0x04
			 0x0800 0x00 0x00 0x03 0xfde8 0x00 0x0f 0x04
			 0x0800 0x00 0x00 0x04 0xfde8 0x00 0x0c 0x04
			 0x1000 0x00 0x00 0x01 0xfde8 0x00 0x0e 0x04
			 0x1000 0x00 0x00 0x02 0xfde8 0x00 0x0f 0x04
			 0x1000 0x00 0x00 0x03 0xfde8 0x00 0x0c 0x04
			 0x1000 0x00 0x00 0x04 0xfde8 0x00 0x0d 0x04
			 0x1800 0x00 0x00 0x01 0xfde8 0x00 0x0f 0x04
			 0x1800 0x00 0x00 0x02 0xfde8 0x00 0x0c 0x04
			 0x1800 0x00 0x00 0x03 0xfde8 0x00 0x0d 0x04
			 0x1800 0x00 0x00 0x04 0xfde8 0x00 0x0e 0x04>;
	#size-cells = <0x02>;
	device_type = "pci";
	interrupt-map-mask = <0x1800 0x00 0x00 0x07>;
	compatible = "pci-host-ecam-generic";
	ranges = <0x2000000 0xf1 0x10000000 0xf1 0x10000000 0x00 0x2000000
		  0x43000000 0xf0 0x00 0xf0 0x00 0x01 0x00>;

	// Alternative layouts. These require changes to QEMU cmdline.
	//ranges = <0x2000000 0x5 0x10000000 0x5 0x10000000 0x00 0x2000000
	//	  0x43000000 0x4 0x00 0x4 0x00 0x01 0x00>;
	//ranges = <0x2000000 0x210 0x10000000 0x210 0x10000000 0x00 0x2000000
	//	  0x43000000 0x200 0x00 0x200 0x00 0x01 0x00>;

	//reg = <0x210 0x00000000 0x00 0x10000000>;
	reg = <0xf1 0x00 0x00 0x10000000>;
	#interrupt-cells = <0x01>;
	status = "okay";
	linux,pci-domain = <0x01>;

	// These IOMMU props together with the xen_iommu node enable
	// grant mappings. Remove them to use foreign mappings.
	// Mask 0 to map all PCI devs onto the same IOMMU id.  */
	iommu-map-mask = <0x00>;
	iommu-map = <0x00 &grants 0x00 0x10000>;
};

grants: xen_iommu {
	#iommu-cells = <0x01>;
	compatible = "xen,grant-dma";
};
